#include <REGX52.H>

sbit RCK = P3 ^ 5;
sbit SCK = P3 ^ 6;
sbit SER = P3 ^ 4;

void WriteByteTo74HC595(unsigned char Byte)
{
	unsigned char i;
	for (i = 0; i < 8; i++)
	{
		SER = Byte & (0x80 >> i);
		SCK = 1;
		SCK = 0;
	}
	
	RCK = 1;
	RCK = 0;
}

// Delay for @11.0592MHz
void DelayMs(unsigned int xms)
{
	unsigned char i, j;
	
	while (xms--)
	{
		for (i = 2; i > 0; i--)
		{
			for (j = 199; j > 0; j--);
		}
	}
}

void ShowLatticeDisplayColumn(unsigned char Column, Data)
{
	WriteByteTo74HC595(Data);
	P0 = ~(0x80 >> Column);
	DelayMs(1);
	P0 = 0xFF;
}

unsigned char code Title[] = {
	0x00,0x00,0x00,0x00,0x00,0x00,0x00,0x00,
	0x38,0x44,0x44,0x44,0x38,0x00,0x7C,0x00,
	0x1C,0x14,0x7C,0x00,0x00,0x7C,0x20,0x18,
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	0x2E,0x34,0x20,0x00,0x00,0x00,0x00,0x00
};

void InitLatticeDisplay()
{
	SCK = 0;
	RCK = 0;
}

int main()
{
	unsigned char i, Offset = 0, Count = 0;
	
	InitLatticeDisplay();
	
	while (1)
	{
		for (i = 0; i < 8; i++)
		{
			ShowLatticeDisplayColumn(i, Title[i + Offset]);
		}
		
		Count++;
		if (Count > 20)
		{
			Count = 0;
			Offset++;
			
			if (Offset > 72)
			{
				Offset = 0;
			}
		}
	}
}
